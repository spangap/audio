## esp-idf/Kconfig
```kconfig
# Audio engine tunables. This straddle DEFINES the knobs; a board sets their
# values via its straddle.yaml `kconfig:` block (a non-buildable board's
# sdkconfig.defaults is ignored, so hardware values must live there). No magic
# constants in the .cpp — every pin/tunable is a CONFIG_AUDIO_*.
menu "Audio (spangap/audio)"

config AUDIO_OUT_ENABLE
    bool "Speaker output"
    default y

config AUDIO_IN_ENABLE
    bool "Microphone input"
    default y

choice AUDIO_IN_MODE
    prompt "Mic I2S mode"
    default AUDIO_IN_MODE_STD
    help
      Standard I2S for an I2C/SPI-configured codec (ES7210); PDM for a raw
      PDM microphone (no control bus).
config AUDIO_IN_MODE_STD
    bool "Standard I2S (codec, e.g. ES7210)"
config AUDIO_IN_MODE_PDM
    bool "PDM mic"
endchoice

config AUDIO_OUT_I2S_PORT
    int "Speaker I2S controller"
    default 1
config AUDIO_OUT_BCK_GPIO
    int "Speaker BCLK gpio"
    default 7
config AUDIO_OUT_WS_GPIO
    int "Speaker WS gpio"
    default 5
config AUDIO_OUT_DOUT_GPIO
    int "Speaker DATA gpio"
    default 6

config AUDIO_IN_I2S_PORT
    int "Mic I2S controller"
    default 0
config AUDIO_IN_MCLK_GPIO
    int "Mic MCLK gpio (-1 = none, PDM ignores)"
    default 48
config AUDIO_IN_SCK_GPIO
    int "Mic BCLK/SCK gpio (PDM: clock)"
    default 47
config AUDIO_IN_WS_GPIO
    int "Mic WS/LRCK gpio (std only)"
    default 21
config AUDIO_IN_DIN_GPIO
    int "Mic DATA/DIN gpio"
    default 14

config AUDIO_RATE_DEFAULT
    int "Default sample rate (Hz)"
    default 16000
config AUDIO_BLOCK_MS_DEFAULT
    int "Default block size (ms)"
    default 20
config AUDIO_MAX_CLIENTS
    int "Max concurrent ITS clients"
    default 4
config AUDIO_MAX_WAV
    int "Max concurrent WAV streams"
    default 2
config AUDIO_OUT_MIX_MS
    int "Per-client inbound buffering (ms)"
    default 120
config AUDIO_WAV_BUF_MS
    int "WAV read-ahead (ms)"
    default 200

# I2S DMA descriptor pool, per channel. These buffers must live in internal
# DMA-capable RAM, which is scarce on a loaded board (WiFi static RX + SPI DMA
# already compete for it), so keep them modest: desc_num * frame_num frames is
# the whole playback cushion — the MAX98357A has no FIFO, so this DMA pool is
# the ONLY thing that hides a late refill. At 128 frames, 6 descriptors is
# ~48 ms at 16 kHz, enough to ride out a scheduling stall (e.g. an LXMF burst
# on the same core) without the speaker starving. Lower to 3 to reclaim ~1.5 KB
# internal RAM if a board never plays audio under load; raise for more slack.
config AUDIO_DMA_DESC_NUM
    int "I2S DMA descriptor count (per channel)"
    default 6
config AUDIO_DMA_FRAME_NUM
    int "I2S DMA frames per descriptor"
    default 128

endmenu
```
